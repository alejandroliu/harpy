## local-src/package/hostapd-rtl8192cu/Config.in
```kconfig
config BR2_PACKAGE_HOSTAPD_RTL8192CU
	bool "hostapd-rtl8192"
	depends on BR2_TOOLCHAIN_HAS_THREADS # libnl
	select BR2_PACKAGE_LIBNL
	help
	  User space daemon for wireless access points using the RTL8192 driver.

	  It implements IEEE 802.11 access point management,
	  IEEE 802.1X/WPA/WPA2/EAP authenticators, RADIUS client,
	  EAP server and RADIUS authentication server.

	  http://hostap.epitest.fi/

if BR2_PACKAGE_HOSTAPD_RTL8192CU

config BR2_PACKAGE_HOSTAPD_RTL8192CU_EAP
	bool "Enable EAP"
	help
	  Enable support for EAP and RADIUS.

config BR2_PACKAGE_HOSTAPD_RTL8192CU_WPS
	bool "Enable WPS"
	help
	  Enable support for Wi-Fi Protected Setup.

endif

comment "hostapd needs a toolchain w/ threads"
	depends on !BR2_TOOLCHAIN_HAS_THREADS
```
